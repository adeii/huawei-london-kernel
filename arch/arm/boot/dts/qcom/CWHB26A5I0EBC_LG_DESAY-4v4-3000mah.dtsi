cw,HB26A5I0EBC_LG_DESAY-4v4-3000mah {
    cw,batt-id-kohm = <200>;
    cw,battery-type = "HB26A5I0EBC_LG_DESAY-4v4-3000mah";
    cw,colum = <4>;
    cw,raw = <64>;
    cw,nom_cap_uah = <3000000>;
    cw,model_data =
    <0x17 0xE0 0x5F 0x66 0x66 0x67 0x66 0x65
    0x60 0x5E 0x6C 0x55 0x5E 0x51 0x49 0x43
    0x3C 0x32 0x2B 0x26 0x2D 0x45 0x55 0x41
    0x11 0x8A 0x09 0x37 0x11 0x21 0x5F 0x64
    0x6C 0x70 0x63 0x67 0x3F 0x1C 0x64 0x65
    0x30 0x47 0x1D 0x41 0x80 0x97 0x9B 0x28
    0x62 0x7C 0x94 0xBE 0x80 0x45 0x63 0xFF
    0x1B 0x00 0x64 0xA5 0xB5 0xC1 0x00 0xFF >,
    <0x17 0xA0 0x61 0x65 0x65 0x65 0x64 0x62
    0x5E 0x61 0x63 0x57 0x59 0x4E 0x47 0x41
    0x38 0x30 0x29 0x26 0x30 0x46 0x52 0x3E
    0x19 0x8E 0x09 0x37 0x11 0x21 0x5F 0x64
    0x6C 0x70 0x63 0x67 0x3F 0x1C 0x64 0x65
    0x30 0x47 0x1D 0x41 0x80 0x97 0x9B 0x28
    0x62 0x7C 0x94 0xBE 0x80 0x45 0x63 0xFF
    0x22 0x00 0x55 0xA5 0xB5 0xC1 0x01 0xFF >,
    <0x17 0x42 0x63 0x62 0x64 0x62 0x62 0x5D
    0x5B 0x67 0x56 0x59 0x52 0x49 0x44 0x3D
    0x34 0x2C 0x27 0x27 0x33 0x47 0x4F 0x37
    0x25 0x94 0x09 0x37 0x11 0x21 0x5F 0x64
    0x6C 0x70 0x63 0x67 0x3F 0x1C 0x64 0x65
    0x30 0x45 0x1D 0x41 0x80 0x97 0x9B 0x28
    0x62 0x7C 0x94 0xBE 0x80 0x45 0x63 0xFF
    0x2A 0x00 0x50 0xA5 0xB5 0xC1 0x02 0xFF >,
    <0x15 0x65 0x59 0x57 0x54 0x52 0x5D 0x52
    0x4E 0x51 0x47 0x42 0x3C 0x35 0x2F 0x29
    0x23 0x1F 0x23 0x2D 0x40 0x4B 0x39 0x1B
    0x4E 0xB1 0x09 0x37 0x11 0x21 0x5F 0x64
    0x6C 0x70 0x63 0x67 0x3F 0x1C 0x64 0x65
    0x30 0x45 0x1D 0x41 0x80 0x97 0x9B 0x28
    0x62 0x7C 0x94 0xBE 0x80 0x45 0x63 0xFF
    0x33 0x00 0x4B 0xA5 0xB5 0xC1 0x03 0xFF >;
cw,model_data_hltherm =
    <0x18 0x42 0x60 0x64 0x6B 0x69 0x69 0x66
    0x64 0x5D 0x6B 0x5F 0x5B 0x59 0x4D 0x46
    0x40 0x38 0x2D 0x28 0x2B 0x42 0x4E 0x4E
    0x17 0x52 0x08 0xB4 0x2E 0x4E 0x5B 0x65
    0x70 0x68 0x63 0x67 0x3E 0x1B 0x84 0x39
    0x13 0x4D 0x1C 0x4F 0x81 0x97 0x9A 0x1A
    0x62 0x7A 0x95 0xBF 0x4C 0x3A 0x54 0xFF
    0x3A 0x00 0x64 0xA5 0xB5 0xC1 0x46 0xAE >,
    <0x18 0x42 0x60 0x64 0x6B 0x69 0x69 0x66
    0x64 0x5D 0x6B 0x5F 0x5B 0x59 0x4D 0x46
    0x40 0x38 0x2D 0x28 0x2B 0x42 0x4E 0x4E
    0x17 0x52 0x08 0xB4 0x2E 0x4E 0x5B 0x65
    0x70 0x68 0x63 0x67 0x3E 0x1B 0x84 0x39
    0x13 0x4D 0x1C 0x4F 0x81 0x97 0x9A 0x1A
    0x62 0x7A 0x95 0xBF 0x4C 0x3A 0x54 0xFF
    0x3A 0x00 0x64 0xA5 0xB5 0xC1 0x46 0xAE >,
    <0x18 0x42 0x60 0x64 0x6B 0x69 0x69 0x66
    0x64 0x5D 0x6B 0x5F 0x5B 0x59 0x4D 0x46
    0x40 0x38 0x2D 0x28 0x2B 0x42 0x4E 0x4E
    0x17 0x52 0x08 0xB4 0x2E 0x4E 0x5B 0x65
    0x70 0x68 0x63 0x67 0x3E 0x1B 0x84 0x39
    0x13 0x4D 0x1C 0x4F 0x81 0x97 0x9A 0x1A
    0x62 0x7A 0x95 0xBF 0x4C 0x3A 0x54 0xFF
    0x3A 0x00 0x64 0xA5 0xB5 0xC1 0x46 0xAE >,
    <0x18 0x42 0x60 0x64 0x6B 0x69 0x69 0x66
    0x64 0x5D 0x6B 0x5F 0x5B 0x59 0x4D 0x46
    0x40 0x38 0x2D 0x28 0x2B 0x42 0x4E 0x4E
    0x17 0x52 0x08 0xB4 0x2E 0x4E 0x5B 0x65
    0x70 0x68 0x63 0x67 0x3E 0x1B 0x84 0x39
    0x13 0x4D 0x1C 0x4F 0x81 0x97 0x9A 0x1A
    0x62 0x7A 0x95 0xBF 0x4C 0x3A 0x54 0xFF
    0x3A 0x00 0x64 0xA5 0xB5 0xC1 0x46 0xAE >;

};
